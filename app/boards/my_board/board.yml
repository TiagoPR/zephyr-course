## app/boards/my_board/board.yml
```yaml
board:
  name: my_board 
  full_name: "My board"
  vendor: iomico
  socs:
  - name: nrf52833
```

## app/boards/my_board/my_board_defconfig
```kconfig
# nRF52 BBC_MICROBIT_V2 board configuration
#
# Copyright (c) 2020 Lingao Meng
# SPDX-License-Identifier: Apache-2.0

# enable GPIO
CONFIG_GPIO=y

# clock control
CONFIG_CLOCK_CONTROL_NRF_K32SRC_RC=y
CONFIG_CLOCK_CONTROL_NRF_K32SRC_250PPM=y

# enable uart driver
CONFIG_SERIAL=y

# enable console
CONFIG_CONSOLE=y
CONFIG_UART_CONSOLE=y
```
